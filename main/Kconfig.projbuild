## main/Kconfig.projbuild
```kconfig
menu "App configuration"

    config APP_WIFI_SSID
        string "Default Wi-Fi SSID"
        default ""
        help
            Seeded into NVS on first boot if no network has been configured.

    config APP_WIFI_PASSWORD
        string "Default Wi-Fi password"
        default ""
        help
            Set this in the git-ignored sdkconfig.secrets, never in sdkconfig.defaults.

    config APP_OTA_MANIFEST_URL
        string "OTA manifest URL"
        default "https://github.com/mafonso/fs-bms/releases/latest/download/version.json"

    config APP_BMS_DEFAULT_PASSKEY
        int "Default BMS pairing passkey"
        range 0 999999
        default 123456
        help
            Felicity's default BLE passkey, used until one is set with `bms pin`.

    config APP_HOSTNAME_PREFIX
        string "Hostname prefix"
        default "fs-bms"
        help
            The device hostname is <prefix>-<last 3 MAC bytes>, also advertised over mDNS.

endmenu
```
